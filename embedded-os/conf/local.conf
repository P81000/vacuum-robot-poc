## embedded-os/conf/local.conf
```bitbake
LICENSE_FLAGS_ACCEPTED += "commercial"

IMAGE_INSTALL:append = " iproute2 net-tools bash ros-core ros-base ros-humble-vacuum-navigator"

TMPDIR = "/home/yoctouser/native-tmp"

PARALLEL_MAKE:pn-rust-llvm-native = "-j 4"
PARALLEL_MAKE:pn-rust-native = "-j 4"
```

## embedded-os/meta-vacuum/conf/layer.conf
```bitbake
# We have a conf and classes directory, add to BBPATH
BBPATH .= ":${LAYERDIR}"

# We have recipes-* directories, add to BBFILES
BBFILES += "${LAYERDIR}/recipes-*/*/*.bb \
            ${LAYERDIR}/recipes-*/*/*.bbappend"

BBFILE_COLLECTIONS += "meta-vacuum"
BBFILE_PATTERN_meta-vacuum = "^${LAYERDIR}/"
BBFILE_PRIORITY_meta-vacuum = "6"

LAYERDEPENDS_meta-vacuum = "core"
LAYERSERIES_COMPAT_meta-vacuum = "kirkstone"
```
